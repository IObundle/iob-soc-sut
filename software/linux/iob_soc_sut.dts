// SPDX-License-Identifier: (GPL-2.0 OR MIT)
/* Copyright (c) 2024 IObundle */

/dts-v1/;

/ {
    #address-cells = <1>;
    #size-cells = <1>;
    model = "IOb-SoC, VexRiscv";
    compatible = "IOb-SoC, VexRiscv";
    // CPU
    // Memory
    // Choosen
    soc {
        #address-cells = <1>;
        #size-cells = <1>;
        compatible = "iobundle,iob-soc", "simple-bus";
        ranges;

        // Other SOC peripherals go here

        // Add this Node to device tree
        SUT0: sut@/*SUT0_ADDR_MACRO*/ {
            compatible = "iobundle,sut0";
            reg = <0x/*SUT0_ADDR_MACRO*/ 0x100>;
        };

    };
};
